## boards/arm/qemu_cortex_m4f/qemu_cortex_m4f_defconfig
```kconfig
# SPDX-License-Identifier: Apache-2.0

CONFIG_SOC_SERIES_STM32F4X=y
CONFIG_SOC_STM32F405XG=y
CONFIG_QEMU_ICOUNT_SHIFT=8

# Enable clock configuration
CONFIG_CLOCK_CONTROL=y

# Enable pinmux
CONFIG_PINMUX=y

# Enable GPIO
CONFIG_GPIO=y

# Enable serial
CONFIG_SERIAL=y

# Enable console
CONFIG_CONSOLE=y
CONFIG_UART_CONSOLE=y
```

## tests/misc/print_format/testcase.yaml
```yaml
tests:
  printk.format:
    harness: console
    harness_config:
      type: multi_line
      ordered: true
      regex:
      - "d8"
      - "d16"
      - "d32"
      - "d64"
      - "i8"
      - "i16"
      - "i32"
      - "i64"
      - "o8"
      - "o16"
      - "o32"
      - "o64"
      - "u8"
      - "u16"
      - "u32"
      - "u64"
      - "x8"
      - "x10"
      - "x20"
      - "x40"
      - "X8"
      - "X10"
      - "X20"
      - "X40"
```
