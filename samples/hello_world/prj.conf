## CMakeLists.txt
```
# SPDX-License-Identifier: Apache-2.0

cmake_minimum_required(VERSION 3.20.0)

find_package(Zephyr REQUIRED HINTS $ENV{ZEPHYR_BASE})
project(hello_world)

target_sources(app PRIVATE src/main.c src/test.c)
```

## prj.conf
```kconfig
CONFIG_NEWLIB_LIBC=y
CONFIG_NEWLIB_LIBC_NANO=n
```

## src/main.c
```c
/*
 * Copyright (c) 2012-2014 Wind River Systems, Inc.
 *
 * SPDX-License-Identifier: Apache-2.0
 */

#include <zephyr/zephyr.h>

extern __weak void test(int a, int b);

void main(void)
{
	printk("Hello World! %s\n", CONFIG_BOARD);

	if (test != NULL) {
		test(1, 2);
	}

	printk("Done\n");
}
```

## src/dwt.h
```c
#pragma once

#include <zephyr.h>

static ALWAYS_INLINE void dwt_start(void)
{
	DWT->CYCCNT = 0;

	__DSB();
	__ISB();

	DWT->CTRL |= DWT_CTRL_CYCCNTENA_Msk;
}

static ALWAYS_INLINE uint32_t dwt_stop(void)
{
	DWT->CTRL &= ~DWT_CTRL_CYCCNTENA_Msk;
	return DWT->CYCCNT;
}
```

## src/test.c
```c
#include <zephyr/zephyr.h>

#if 1
void test(int a, int b)
{
	printk("Hello from test(%d, %d)\n", a, b);
}
#endif
```
